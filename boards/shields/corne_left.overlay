
/ {
  split_inputs {
    #address-cells = <1>;
    #size-cells = <0>;

    trackpad_split: trackpad@0 {
      compatible = "zmk,input-split";
      reg = <0>;
    };
  };

  trackpad_listener: trackpad_listener {
    compatible = "zmk,input-listener";
    status = "okay";
    device = <&tracpad_split>;
  };
};
