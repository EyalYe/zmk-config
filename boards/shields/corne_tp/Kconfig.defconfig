## boards/shields/corne_tp/Kconfig.defconfig
```kconfig
if SHIELD_CORNE_TP_LEFT

config ZMK_KEYBOARD_NAME
    default "Corne-tp"

config ZMK_SPLIT_ROLE_CENTRAL
    default y

endif

if SHIELD_CORNE_TP_LEFT || SHIELD_CORNE_TP_RIGHT

config ZMK_INPUT
    default y

config ZMK_POINTING
    default y

config ZMK_SPLIT
    default y

config I2C
    default y

endif
```

## config/boards/shields/ddisp/Kconfig.shield
```kconfig
# Copyright (c) 2024 The ZMK Contributors
# SPDX-License-Identifier: MIT

config SHIELD_DDISP
	def_bool $(shields_list_contains,ddisp)
```
