/*
 * Copyright (c) 2020 Pete Johanson
 *
 * SPDX-License-Identifier: MIT
 */

#include "corne_tp.dtsi"

&kscan0 {
    col-gpios
        = <&pro_micro 21 GPIO_ACTIVE_HIGH>
        , <&pro_micro 20 GPIO_ACTIVE_HIGH>
        , <&pro_micro 19 GPIO_ACTIVE_HIGH>
        , <&pro_micro 18 GPIO_ACTIVE_HIGH>
        , <&pro_micro 15 GPIO_ACTIVE_HIGH>
        , <&pro_micro 14 GPIO_ACTIVE_HIGH>
        ;
};

/ {
  split_inputs {
    #address-cells = <1>;
    #size-cells = <0>;

    trackpad_split: trackpad@0 {
      compatible = "zmk,input-split";
      reg = <0>;
    };
  };

  trackpad_listener: trackpad_listener {
    compatible = "zmk,input-listener";
    status = "okay";
    device = <&trackpad_split>;
};
